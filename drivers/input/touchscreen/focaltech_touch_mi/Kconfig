## drivers/input/touchscreen/focaltech_touch_mi/Kconfig
```kconfig
#
# Focaltech Touchscreen driver configuration
#

config TOUCHSCREEN_FTS_MI
	tristate "Focaltech Touchscreen"
	depends on I2C
	default n
	select TOUCHSCREEN_COMMON
	help
	  Say Y here if you have Focaltech touch panel.
	  If unsure, say N.

config TOUCHSCREEN_FTS_POWER_SUPPLY_MI
        bool "USB Power Supply"
        default n
        help
            Say y here if phone type is perseus
            If unsure, say N
```
